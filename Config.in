## Config.in
```kconfig
source "$BR2_EXTERNAL_LICHEEPIZERODOCK_EXT_BASE_PATH/package/lradc_check/Config.in"
```

## configs/sipeed_licheepi_zero_defconfig
```kconfig
BR2_arm=y
BR2_cortex_a7=y
BR2_ARM_FPU_VFPV4=y
BR2_TOOLCHAIN_EXTERNAL=y
BR2_TOOLCHAIN_EXTERNAL_BOOTLIN=y
BR2_TOOLCHAIN_EXTERNAL_BOOTLIN_ARMV7_EABIHF_GLIBC_STABLE=y
BR2_GLOBAL_PATCH_DIR="$(BR2_EXTERNAL_LICHEEPIZERODOCK_EXT_BASE_PATH)/patches"
BR2_DOWNLOAD_FORCE_CHECK_HASHES=y
BR2_TARGET_GENERIC_HOSTNAME="licheepi-zero"
BR2_TARGET_GENERIC_ISSUE="Welcome to Buildroot for the LicheePi Zero"
BR2_TARGET_GENERIC_GETTY_PORT="ttyS0"
BR2_TARGET_GENERIC_GETTY_BAUDRATE_115200=y
BR2_ROOTFS_OVERLAY="$(BR2_EXTERNAL_LICHEEPIZERODOCK_EXT_BASE_PATH)/board/licheepi_zero/rootfs_overlay/"
BR2_ROOTFS_POST_IMAGE_SCRIPT="support/scripts/genimage.sh $(BR2_EXTERNAL_LICHEEPIZERODOCK_EXT_BASE_PATH)/swupdate/make_swu.sh"
BR2_ROOTFS_POST_SCRIPT_ARGS="-c $(BR2_EXTERNAL_LICHEEPIZERODOCK_EXT_BASE_PATH)/board/licheepi_zero/genimage.cfg"
BR2_LINUX_KERNEL=y
BR2_LINUX_KERNEL_CUSTOM_VERSION=y
BR2_LINUX_KERNEL_CUSTOM_VERSION_VALUE="6.12.43"
BR2_LINUX_KERNEL_DEFCONFIG="sunxi"
BR2_LINUX_KERNEL_CONFIG_FRAGMENT_FILES="$(BR2_EXTERNAL_LICHEEPIZERODOCK_EXT_BASE_PATH)/board/licheepi_zero/linux-sunxi-extra.config"
BR2_LINUX_KERNEL_DTS_SUPPORT=y
BR2_LINUX_KERNEL_INTREE_DTS_NAME="allwinner/sun8i-v3s-licheepi-zero allwinner/sun8i-v3s-licheepi-zero-dock allwinner/sun8i-v3s-licheepi-zero-dock-ex"
BR2_PACKAGE_ALSA_UTILS=y
BR2_PACKAGE_ALSA_UTILS_AMIXER=y
BR2_PACKAGE_ALSA_UTILS_APLAY=y
BR2_PACKAGE_E2FSPROGS=y
BR2_PACKAGE_E2FSPROGS_RESIZE2FS=y
BR2_PACKAGE_LINUX_FIRMWARE=y
BR2_PACKAGE_LINUX_FIRMWARE_RTL_87XX=y
BR2_PACKAGE_UBOOT_TOOLS=y
BR2_PACKAGE_WPA_SUPPLICANT=y
BR2_PACKAGE_WPA_SUPPLICANT_AUTOSCAN=y
BR2_PACKAGE_SWUPDATE=y
BR2_PACKAGE_SWUPDATE_CONFIG="$(BR2_EXTERNAL_LICHEEPIZERODOCK_EXT_BASE_PATH)/board/licheepi_zero/package/swupdate/swupdate.config"
BR2_TARGET_ROOTFS_EXT2=y
BR2_TARGET_ROOTFS_EXT2_4=y
BR2_TARGET_UBOOT=y
BR2_TARGET_UBOOT_BUILD_SYSTEM_KCONFIG=y
BR2_TARGET_UBOOT_CUSTOM_VERSION=y
BR2_TARGET_UBOOT_CUSTOM_VERSION_VALUE="2025.07"
BR2_TARGET_UBOOT_USE_CUSTOM_CONFIG=y
BR2_TARGET_UBOOT_CUSTOM_CONFIG_FILE="$(BR2_EXTERNAL_LICHEEPIZERODOCK_EXT_BASE_PATH)/board/licheepi_zero/uboot-fragment.config"
BR2_TARGET_UBOOT_NEEDS_DTC=y
BR2_TARGET_UBOOT_NEEDS_PYLIBFDT=y
BR2_TARGET_UBOOT_NEEDS_OPENSSL=y
BR2_TARGET_UBOOT_NEEDS_GNUTLS=y
BR2_TARGET_UBOOT_FORMAT_CUSTOM=y
BR2_TARGET_UBOOT_FORMAT_CUSTOM_NAME="u-boot-sunxi-with-spl.bin"
BR2_PACKAGE_HOST_DOSFSTOOLS=y
BR2_PACKAGE_HOST_GENIMAGE=y
BR2_PACKAGE_HOST_MTOOLS=y
BR2_PACKAGE_HOST_UBOOT_TOOLS=y
BR2_PACKAGE_HOST_UBOOT_TOOLS_BOOT_SCRIPT=y
BR2_PACKAGE_HOST_UBOOT_TOOLS_BOOT_SCRIPT_SOURCE="$(BR2_EXTERNAL_LICHEEPIZERODOCK_EXT_BASE_PATH)/board/licheepi_zero/boot.cmd"
```

## package/lradc_check/Config.in
```kconfig
config BR2_PACKAGE_LRADC_CHECK
  bool "lradc_check (LRADC key monitor)"
  depends on BR2_PACKAGE_HOST_RUSTC_TARGET_ARCH_SUPPORTS
  select BR2_PACKAGE_HOST_RUSTC
  help
    LRADC Key Monitor for Lichee Pi Zero.

    Rust + WebSocket + evdev で /dev/input/event0 を監視して、
    Webブラウザからボタン状態をリアルタイム表示するツールです。

    https://github.com/AdenoBluesky/lradc_check

config BR2_PACKAGE_LRADC_CHECK_AUTOSTART
    bool "start lradc_check at boot"
    depends on BR2_PACKAGE_LRADC_CHECK
    default y
    help
      If enabled, lradc_check will be started automatically
      at system boot by an init script.

config BR2_PACKAGE_LRADC_CHECK_PORT
    int "lradc_check listen port"
    depends on BR2_PACKAGE_LRADC_CHECK
    default 8081
    range 1024 65535
    help
      TCP port for lradc_check HTTP/WebSocket server.
      Example: 8081
```
